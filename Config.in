## package/batocera/core/batocera-system/Config.in
```kconfig
w
##### define variables to use in this file
if BR2_PACKAGE_BATOCERA_RPI_VCORE || BR2_PACKAGE_BATOCERA_RPI_MESA3D
	config BR2_PACKAGE_BATOCERA_RPI_ANY
	bool "any rpi"
	default y
endif

if BR2_PACKAGE_BATOCERA_TARGET_BCM2835	|| \
   BR2_PACKAGE_BATOCERA_TARGET_BCM2836	|| \
   BR2_PACKAGE_BATOCERA_TARGET_BCM2837
	config BR2_PACKAGE_BATOCERA_TARGET_RPI_GLES2
	bool "rpi_gles2"
	default y
	help
	  Selected when a RaspberryPi gles2 platform is being built
endif

if BR2_PACKAGE_BATOCERA_TARGET_X86 || BR2_PACKAGE_BATOCERA_TARGET_X86_64_ANY
	config BR2_PACKAGE_BATOCERA_TARGET_X86_ANY
	bool "any x86 or x86_64"
	default y
endif

if BR2_PACKAGE_BATOCERA_TARGET_X86_64		|| \
   BR2_PACKAGE_BATOCERA_TARGET_X86_64_ZNVER2	|| \
   BR2_PACKAGE_BATOCERA_TARGET_PS4
	config BR2_PACKAGE_BATOCERA_TARGET_X86_64_ANY
	bool "any x86_64"
	default y
endif

config BR2_PACKAGE_BATOCERA_GLES2
	bool "target has gles2 support"
	default y

##########################################
config BR2_PACKAGE_BATOCERA_MUSIC_SUPPORT
	bool "batocera.linux music formats support"

	# MIDI
	select BR2_PACKAGE_FLUIDSYNTH

	# MIDI tools
	select BR2_PACKAGE_ALSA_UTILS_ACONNECT  if BR2_PACKAGE_ALSA_UTILS
	select BR2_PACKAGE_ALSA_UTILS_APLAYMIDI if BR2_PACKAGE_ALSA_UTILS

	# Modules
	select BR2_PACKAGE_LIBMODPLUG

	# MP3
	select BR2_PACKAGE_LIBMAD

	help
	  Music support packages (MIDI, MOD, S3M, XM, ....)

config BR2_PACKAGE_BATOCERA_VULKAN
	bool "batocera.linux Vulkan support"

	# Vulkan headers, loaders, SPIR-V, glsLang
	select BR2_PACKAGE_VULKAN_VOLK
	select BR2_PACKAGE_VULKAN_TOOLS
	select BR2_PACKAGE_SPIRV_TOOLS

	# Vulkan mesa drivers
	select BR2_PACKAGE_MESA3D_VULKAN_DRIVER_INTEL		if BR2_PACKAGE_BATOCERA_TARGET_X86_ANY
	select BR2_PACKAGE_MESA3D_VULKAN_DRIVER_HASWELL		if BR2_PACKAGE_BATOCERA_TARGET_X86_ANY
	select BR2_PACKAGE_MESA3D_VULKAN_DRIVER_AMD		if BR2_PACKAGE_BATOCERA_TARGET_X86_ANY
	select BR2_PACKAGE_MESA3D_VULKAN_DRIVER_BROADCOM	if BR2_PACKAGE_BATOCERA_RPI_MESA3D
	select BR2_PACKAGE_MESA3D_VULKAN_DRIVER_PANFROST	if BR2_PACKAGE_BATOCERA_PANFROST_MESA3D
	select BR2_PACKAGE_MESA3D_VULKAN_DRIVER_FREEDRENO	if BR2_PACKAGE_BATOCERA_FREEDRENO_MESA3D

	help
	  Vulkan support for batocera.linux

config BR2_PACKAGE_BATOCERA_SYSTEM
	bool "batocera.linux minimal"

	# RISC-V support needs a hack here to declare as RV64GC, needed for Rust
	select BR2_RISCV_ISA_RVC		if BR2_PACKAGE_BATOCERA_TARGET_RISCV

	# minimal system required packages
	select BR2_TARGET_BATOCERA_IMAGES_DEFINITIONS
	select BR2_PACKAGE_BATOCERA_INITRAMFS		# initramfs to boot the system
	select BR2_PACKAGE_BASH				# bash shell, used as the interactive shell
	select BR2_PACKAGE_BATOCERA_EMULATIONSTATION	# emulationstation
	select BR2_PACKAGE_XOSD				if BR2_PACKAGE_XSERVER_XORG_SERVER # osd information displaying
	select BR2_PACKAGE_BATOCERA_BATTERY_CHECKER	if BR2_PACKAGE_XOSD
	select BR2_PACKAGE_UTIL_LINUX_LIBMOUNT		# for util-linux compilation to work (so, may be removed in the future)
	select BR2_PACKAGE_EUDEV_RULES_GEN		# fork of systemd-udev with the goal of obtaining better compatibility with existing software such as OpenRC and Upstart
	#select BR2_PACKAGE_BOOST
	#select BR2_PACKAGE_BOOST_ATOMIC			# library that provides atomic data types and operations on these data types
	select BR2_PACKAGE_UTIL_LINUX_LIBSMARTCOLS	# library is used for smart adaptive formatting of tabular data
	select BR2_PACKAGE_UTIL_LINUX_SETTERM		# Set terminal attributes

	# Python and SSL
	select BR2_PACKAGE_HOST_PYTHON3
	select BR2_PACKAGE_HOST_PYTHON3_SSL
	select BR2_PACKAGE_PYTHON3
	select BR2_PACKAGE_PYTHON3_SSL
	select BR2_PACKAGE_PYTHON3_PYOPENSSL

	select BR2_PACKAGE_BATOCERA_SPLASH			# boot splash
	select BR2_PACKAGE_BATOCERA_SCRIPTS			# batocera scripts
	select BR2_PACKAGE_BATOCERA_RESOLUTION			# batocera resolution
	select BR2_PACKAGE_WGET					# download tools
	select BR2_PACKAGE_LIBCURL_CURL				# download tools
	select BR2_PACKAGE_NGHTTP2				# required for curl http2
	select BR2_PACKAGE_CA_CERTIFICATES			# ssl certificates
	select BR2_PACKAGE_ROCKCHIP_RGA				if BR2_PACKAGE_BATOCERA_TARGET_RK3128 # Used for screen rotation (SDL, Retroarch, Moonlight)

	select BR2_PACKAGE_LIBDRM				if !BR2_PACKAGE_BATOCERA_RPI_VCORE
	select BR2_PACKAGE_BATOCERA_DRMINFO			if BR2_PACKAGE_LIBDRM
	select BR2_PACKAGE_LIBCEC				# libcec
	select BR2_PACKAGE_LIBCEC_LINUX_API			# libcec linux api
	select BR2_SYSTEM_ENABLE_NLS				# locales
	select BR2_PACKAGE_ACPID				if BR2_PACKAGE_BATOCERA_TARGET_X86_ANY
	select BR2_PACKAGE_LIBOPENSSL_BIN			# required to encode the wifi password
	select BR2_PACKAGE_XKEYBOARD_CONFIG			if BR2_PACKAGE_LIBXKBCOMMON # requirement for xkb to work, xkb is used by kodi, even without x for the keyboard

	# music support
	select BR2_PACKAGE_BATOCERA_MUSIC_SUPPORT

	# vulkan
	select BR2_PACKAGE_BATOCERA_VULKAN	if  BR2_PACKAGE_BATOCERA_TARGET_X86_ANY	|| \
						    BR2_PACKAGE_BATOCERA_TARGET_BCM2711	|| \
						    BR2_PACKAGE_BATOCERA_TARGET_BCM2712	|| \
						    BR2_PACKAGE_BATOCERA_TARGET_RISCV

	# gpu drivers
	select BR2_PACKAGE_BATOCERA_GPU_X86	if BR2_PACKAGE_BATOCERA_TARGET_X86_ANY

	# SDL2
	select BR2_PACKAGE_BATOCERA_SDL2

	# xorg
	select BR2_PACKAGE_BATOCERA_XORG	if BR2_PACKAGE_BATOCERA_TARGET_X86_ANY

	# compression tools
	select BR2_PACKAGE_UNZIP	# for /userdata/system/upgrade/share.zip
	select BR2_PACKAGE_XZ		# for updates
	select BR2_PACKAGE_ZSTD		# for btrfs compression
	select BR2_PACKAGE_LZ4		# for initramfs compression

	# script tool
	select BR2_PACKAGE_DIALOG

	# required gcc flags
	# required for different emulators, i suggest to enable it always to not have different behavior depending on boards
	select BR2_GCC_ENABLE_OPENMP

	# leds
	select BR2_PACKAGE_AYN_PLATFORM		if BR2_PACKAGE_BATOCERA_TARGET_X86_ANY

	help
	  Install the batocera.linux system files

config BR2_PACKAGE_BATOCERA_DEV
	bool "add dev options"

	help
	  Install dev packages for batocera.linux

config BR2_PACKAGE_BATOCERA_DEBUG
	bool "add debug options"

	help
	  Install debug packages for batocera.linux

config BR2_TARGET_BATOCERA_IMAGES_DEFINITIONS
	bool "target images definitions"
	config BR2_TARGET_BATOCERA_IMAGES
	string "target images"
	choice
	prompt "batocera.linux target"
	help
	  Select batocera.linux target hardware

# Raspberry
# ---------------------------------------
config BR2_PACKAGE_BATOCERA_TARGET_BCM2835
	bool "bcm2835"

# Rockchip
# ---------------------------------------
config BR2_PACKAGE_BATOCERA_TARGET_RK3128
	bool "rk3128"

config BR2_PACKAGE_BATOCERA_TARGET_RK3326
	bool "rk3326"

config BR2_PACKAGE_BATOCERA_TARGET_RK3588
	bool "rk3588"

config BR2_PACKAGE_BATOCERA_TARGET_S812
	bool "s812"

config BR2_PACKAGE_BATOCERA_TARGET_AARCH64_MALI
	bool "aarch64-mali"

config BR2_PACKAGE_BATOCERA_TARGET_AARCH64_MESA
	bool "aarch64-mesa"

config BR2_PACKAGE_BATOCERA_TARGET_ARMV7_MESA
	bool "armv7-mesa"

# Saphira
#-------------------------------------
config BR2_PACKAGE_BATOCERA_TARGET_SAPHIRA
    bool "saphira"

# PC
# ------------------------------------
config BR2_PACKAGE_BATOCERA_TARGET_X86_64
	bool "x86_64"

# Snapdragon & Samsung
# -------------------------------------
config BR2_PACKAGE_BATOCERA_TARGET_XU4
	bool "xu4"

# RISCV
# -------------------------------------
config BR2_PACKAGE_BATOCERA_TARGET_RISCV
	bool "riscv"

endchoice

config BR2_PACKAGE_BATOCERA_EXTRAS
	bool "batocera.linux tools packages selection"

	help
	  Tools to extends the batocera system (but not required)

config BR2_PACKAGE_BATOCERA_TOOLS
	bool "batocera.linux system tools packages selection"

	help
	  System tools


config BR2_PACKAGE_BATOCERA_RPI_VCORE
	bool "batocera.linux support vcore RPI"

	select BR2_PACKAGE_RPI_USERLAND
	select BR2_PACKAGE_RASPI2PNG # screenshots

config BR2_PACKAGE_BATOCERA_RPI_MESA3D
	bool "batocera.linux driver mesa RPI"

	select BR2_PACKAGE_MESA3D
	select BR2_PACKAGE_MESA3D_OPENGL_ES
	select BR2_PACKAGE_MESA3D_OPENGL_EGL
	select BR2_PACKAGE_MESA3D_GALLIUM_DRIVER_VC4
	select BR2_PACKAGE_MESA3D_GALLIUM_DRIVER_V3D
	select BR2_PACKAGE_MESA3D_OPENGL_GLX		if BR2_PACKAGE_XORG7 # OpenGL GLX support
	select BR2_PACKAGE_MESA3D_DEMOS			if BR2_PACKAGE_XORG7 # glxinfo etc
	select BR2_PACKAGE_LIBGLVND			if BR2_PACKAGE_XORG7 # opengl


config BR2_PACKAGE_BATOCERA_LIMA_MESA3D
	bool "batocera.linux driver mesa LIMA"

	select BR2_PACKAGE_MESA3D
	select BR2_PACKAGE_MESA3D_OPENGL_ES
	select BR2_PACKAGE_MESA3D_OPENGL_EGL
	select BR2_PACKAGE_MESA3D_GALLIUM_DRIVER_LIMA

config BR2_PACKAGE_BATOCERA_PANFROST_MESA3D
	bool "batocera.linux driver mesa PANFROST"

	select BR2_PACKAGE_MESA3D
	select BR2_PACKAGE_MESA3D_OPENGL_ES
	select BR2_PACKAGE_MESA3D_OPENGL_EGL
	select BR2_PACKAGE_MESA3D_GALLIUM_DRIVER_PANFROST

config BR2_PACKAGE_BATOCERA_ASAHI_MESA3D
    bool "batocera.linux driver mesa Asahi"

    select BR2_PACKAGE_MESA3D
    select BR2_PACKAGE_MESA3D_OPENGL_ES
    select BR2_PACKAGE_MESA3D_OPENGL_EGL
    select BR2_PACKAGE_MESA3D_GALLIUM_DRIVER_ASAHI

config BR2_PACKAGE_BATOCERA_MALI_G610
	bool "batocera.linux driver mesa MALI"

	select BR2_PACKAGE_MALI_G610

config BR2_PACKAGE_BATOCERA_FREEDRENO_MESA3D
	bool "batocera.linux driver mesa FREEDRENO"

	select BR2_PACKAGE_MESA3D
	select BR2_PACKAGE_MESA3D_OPENGL_ES
	select BR2_PACKAGE_MESA3D_OPENGL_EGL
	select BR2_PACKAGE_MESA3D_GALLIUM_DRIVER_FREEDRENO

config BR2_PACKAGE_BATOCERA_LINUX_FIRMWARES
	bool "batocera.linux Firmwares packages selection"


config BR2_PACKAGE_BATOCERA_SDL2
	bool "BATOCERA SDL2"

	select BR2_PACKAGE_SDL2
	select BR2_PACKAGE_SDL2_GFX
	select BR2_PACKAGE_SDL2_IMAGE
	select BR2_PACKAGE_SDL2_MIXER
	select BR2_PACKAGE_SDL2_TTF
	select BR2_PACKAGE_SDL2_OPENGLES
	select BR2_PACKAGE_SDL2_OPENGL		if BR2_PACKAGE_HAS_LIBGL
	select BR2_PACKAGE_SDL2_X11		if BR2_PACKAGE_XORG7
	select BR2_PACKAGE_SDL2_KMSDRM		if !BR2_PACKAGE_BATOCERA_RPI_VCORE
	select BR2_PACKAGE_SDL2_WAYLAND		if BR2_PACKAGE_BATOCERA_WAYLAND
	select BR2_PACKAGE_FLAC			# flac
	select BR2_PACKAGE_LIBMAD		# mp3
	select BR2_PACKAGE_LIBVORBIS		# ogg

config BR2_PACKAGE_BATOCERA_WAYLAND
	bool "batocera.linux wayland packages selection"

	# Wayland Protocol
	select BR2_PACKAGE_WAYLAND
	select BR2_PACKAGE_WAYLAND_UTILS
	select BR2_PACKAGE_WAYLAND_PROTOCOLS

config BR2_PACKAGE_BATOCERA_WAYLAND_SWAY
	bool "batocera.linux wayland sway packages selection"

	# Wayland Protocol
	select BR2_PACKAGE_BATOCERA_WAYLAND

	# Seat management daemon
	select BR2_PACKAGE_SEATD
	select BR2_PACKAGE_SEATD_DAEMON

config BR2_PACKAGE_BATOCERA_WAYLAND_GAMESCOPE
       bool "batocera.linux wayland gamescope packages selection"

       # Wayland Protocol
       select BR2_PACKAGE_BATOCERA_WAYLAND

       # Seat management daemon
       select BR2_PACKAGE_SEATD
       select BR2_PACKAGE_SEATD_DAEMON

       # Compositor for wayland
       select BR2_PACKAGE_GAMESCOPE

config BR2_PACKAGE_BATOCERA_XWAYLAND
	bool "batocera.linux xwayland packages selection"

	# Xorg emulation layer of Wayland
	select BR2_PACKAGE_XORG7
	select BR2_PACKAGE_XWAYLAND
	select BR2_PACKAGE_WLROOTS_X11
	select BR2_PACKAGE_WLROOTS_XWAYLAND

config BR2_PACKAGE_BATOCERA_XORG
	bool "batocera.linux xorgs packages selection"

	select BR2_PACKAGE_XORG7
	select BR2_PACKAGE_XSERVER_XORG_SERVER

	# xwayland based architecture (no more ddx drivers)
	select BR2_PACKAGE_LIBEPOXY		# required to enable xorg glamor
	select BR2_PACKAGE_WAYLAND_PROTOCOLS	if BR2_PACKAGE_WAYLAND
	select BR2_PACKAGE_XLIB_LIBXCOMPOSITE

	# drivers
	select BR2_PACKAGE_XDRIVER_XF86_INPUT_EVDEV
	select BR2_PACKAGE_XDRIVER_XF86_INPUT_LIBINPUT
	select BR2_PACKAGE_XDRIVER_XF86_INPUT_SYNAPTICS

	# GPU drivers (needed for old Nvidia&AMD cards for edid handshake with display)
	select BR2_PACKAGE_XDRIVER_XF86_VIDEO_AMDGPU			if BR2_PACKAGE_BATOCERA_TARGET_X86_ANY
	select BR2_PACKAGE_XDRIVER_XF86_VIDEO_ATI			if BR2_PACKAGE_BATOCERA_TARGET_X86_ANY
	select BR2_PACKAGE_XDRIVER_XF86_VIDEO_NOUVEAU			if BR2_PACKAGE_BATOCERA_TARGET_X86_ANY
	# select BR2_PACKAGE_XDRIVER_XF86_VIDEO_INTEL			if BR2_PACKAGE_BATOCERA_TARGET_X86_ANY # disabed due to issues with newer intel gpu's
	# nvidia xorg packages are selected by batocera-nvidia package

	# applications
	select BR2_PACKAGE_XAPP_SETXKBMAP
	select BR2_PACKAGE_XAPP_XEV
	select BR2_PACKAGE_XAPP_XINIT
	select BR2_PACKAGE_XAPP_XINPUT
	select BR2_PACKAGE_XAPP_XRANDR			# required for resolution manipulation
	select BR2_PACKAGE_XAPP_XSET			# X11 Xset command
	select BR2_PACKAGE_XAPP_XBACKLIGHT		# set the backlight

	# vendor neutral GL dispatch library
	# already set by nvidia for x86_64, but required on x86 for pcsx2
	# required for RPi4 OpenGL stack
	select BR2_PACKAGE_LIBGLVND			if BR2_PACKAGE_BATOCERA_TARGET_X86_ANY

config BR2_PACKAGE_BATOCERA_GPU_X86
	bool "batocera.linux GPU support for x86 platform"

	# nvidia
	select BR2_PACKAGE_BATOCERA_NVIDIA			if BR2_PACKAGE_BATOCERA_TARGET_X86_64_ANY
	# AMD
	select BR2_PACKAGE_BATOCERA_AMD				if BR2_PACKAGE_BATOCERA_TARGET_X86_64_ANY

	# mesa
	select BR2_PACKAGE_MESA3D
	select BR2_PACKAGE_MESA3D_GALLIUM_DRIVER_I915		if BR2_PACKAGE_BATOCERA_TARGET_X86_ANY	#batocera- Intel legacy
	select BR2_PACKAGE_MESA3D_GALLIUM_DRIVER_CROCUS		if BR2_PACKAGE_BATOCERA_TARGET_X86_ANY	#batocera- Intel Gen4-7
	select BR2_PACKAGE_MESA3D_GALLIUM_DRIVER_SWRAST
	select BR2_PACKAGE_MESA3D_GALLIUM_DRIVER_SVGA
	select BR2_PACKAGE_MESA3D_GALLIUM_DRIVER_IRIS		if BR2_PACKAGE_BATOCERA_TARGET_X86_ANY	#batocera- Intel Gen8+
	select BR2_PACKAGE_MESA3D_GALLIUM_DRIVER_NOUVEAU	if BR2_PACKAGE_BATOCERA_TARGET_X86_ANY
	select BR2_PACKAGE_MESA3D_GALLIUM_DRIVER_R600		if BR2_PACKAGE_BATOCERA_TARGET_X86_ANY
	select BR2_PACKAGE_MESA3D_GALLIUM_DRIVER_RADEONSI	if BR2_PACKAGE_BATOCERA_TARGET_X86_ANY
	select BR2_PACKAGE_MESA3D_GALLIUM_DRIVER_VIRGL		if BR2_PACKAGE_BATOCERA_TARGET_X86_ANY
	select BR2_PACKAGE_MESA3D_GALLIUM_DRIVER_R300		if BR2_PACKAGE_BATOCERA_TARGET_X86_ANY
	select BR2_PACKAGE_MESA3D_GALLIUM_DRIVER_ZINK		if BR2_PACKAGE_BATOCERA_TARGET_X86_ANY	#batocera- possible other platforms
	select BR2_PACKAGE_MESA3D_VDPAU				if BR2_PACKAGE_BATOCERA_TARGET_X86_ANY
	select BR2_PACKAGE_MESA3D_OPENGL_ES
	select BR2_PACKAGE_MESA3D_OPENGL_EGL
	select BR2_PACKAGE_MESA3D_OPENGL_GLX			if BR2_PACKAGE_BATOCERA_TARGET_X86_ANY
	select BR2_PACKAGE_MESA3D_LLVM
	select BR2_PACKAGE_MESA3D_DEMOS

	select BR2_PACKAGE_MESA3D_VIDEO_CODEC_VC1DEC		if BR2_PACKAGE_BATOCERA_TARGET_X86_ANY
	select BR2_PACKAGE_MESA3D_VIDEO_CODEC_H264DEC		if BR2_PACKAGE_BATOCERA_TARGET_X86_ANY
	select BR2_PACKAGE_MESA3D_VIDEO_CODEC_H264ENC		if BR2_PACKAGE_BATOCERA_TARGET_X86_ANY
	select BR2_PACKAGE_MESA3D_VIDEO_CODEC_H265DEC		if BR2_PACKAGE_BATOCERA_TARGET_X86_ANY
	select BR2_PACKAGE_MESA3D_VIDEO_CODEC_H265ENC		if BR2_PACKAGE_BATOCERA_TARGET_X86_ANY
	select BR2_PACKAGE_MESA3D_VIDEO_CODEC_AV1DEC		if BR2_PACKAGE_BATOCERA_TARGET_X86_ANY
	select BR2_PACKAGE_MESA3D_VIDEO_CODEC_AV1ENC		if BR2_PACKAGE_BATOCERA_TARGET_X86_ANY
	select BR2_PACKAGE_MESA3D_VIDEO_CODEC_VP9DEC		if BR2_PACKAGE_BATOCERA_TARGET_X86_ANY

	# utils
	select BR2_PACKAGE_LIBVA_INTEL_DRIVER			if BR2_PACKAGE_BATOCERA_TARGET_X86_ANY
	select BR2_PACKAGE_LIBVA_UTILS				if BR2_PACKAGE_BATOCERA_TARGET_X86_ANY
	select BR2_PACKAGE_VDPAUINFO				if BR2_PACKAGE_BATOCERA_TARGET_X86_ANY

### ### ###
```
