## Config.in
```kconfig
menu "batocera.linux"

menu "System"
  source "$BR2_EXTERNAL_BATOCERA_PATH/package/batocera/core/batocera-system/Config.in"
  source "$BR2_EXTERNAL_BATOCERA_PATH/package/batocera/core/batocera-image/Config.in"
  source "$BR2_EXTERNAL_BATOCERA_PATH/package/batocera/core/batocera-audio/Config.in"
  source "$BR2_EXTERNAL_BATOCERA_PATH/package/batocera/core/batocera-audio-alsa/Config.in"
  source "$BR2_EXTERNAL_BATOCERA_PATH/package/batocera/core/batocera-controller-overlays/Config.in"

  menu "Fonts"
    source "$BR2_EXTERNAL_BATOCERA_PATH/package/batocera/fonts/noto-cjk-fonts/Config.in"
  endmenu

  menu "GPU"
    source "$BR2_EXTERNAL_BATOCERA_PATH/package/batocera/gpu/libmali/Config.in"
    source "$BR2_EXTERNAL_BATOCERA_PATH/package/batocera/gpu/img-gpu-powervr/Config.in"
    source "$BR2_EXTERNAL_BATOCERA_PATH/package/batocera/gpu/img-mesa3d/Config.in"
    source "$BR2_EXTERNAL_BATOCERA_PATH/package/batocera/gpu/mesa-panfork/Config.in"
    source "$BR2_EXTERNAL_BATOCERA_PATH/package/batocera/gpu/mali-G52/Config.in"
    source "$BR2_EXTERNAL_BATOCERA_PATH/package/batocera/gpu/mali-G31/Config.in"
    source "$BR2_EXTERNAL_BATOCERA_PATH/package/batocera/gpu/mali-mp400-gbm/Config.in"
    source "$BR2_EXTERNAL_BATOCERA_PATH/package/batocera/gpu/batocera-nvidia/Config.in"
    source "$BR2_EXTERNAL_BATOCERA_PATH/package/batocera/gpu/batocera-nvidia-driver/Config.in"
    source "$BR2_EXTERNAL_BATOCERA_PATH/package/batocera/gpu/batocera-nvidia-legacy-driver/Config.in"
    source "$BR2_EXTERNAL_BATOCERA_PATH/package/batocera/gpu/batocera-nvidia390-legacy-driver/Config.in"
    source "$BR2_EXTERNAL_BATOCERA_PATH/package/batocera/gpu/rockchip-mpp/Config.in"
    source "$BR2_EXTERNAL_BATOCERA_PATH/package/batocera/gpu/rockchip-rga/Config.in"
    source "$BR2_EXTERNAL_BATOCERA_PATH/package/batocera/gpu/vulkan/glslang/Config.in"
    source "$BR2_EXTERNAL_BATOCERA_PATH/package/batocera/gpu/vulkan/vulkan-samples/Config.in"
    source "$BR2_EXTERNAL_BATOCERA_PATH/package/batocera/gpu/batocera-nvidia-lists/Config.in"
    source "$BR2_EXTERNAL_BATOCERA_PATH/package/batocera/gpu/batocera-amd/Config.in"
    source "$BR2_EXTERNAL_BATOCERA_PATH/package/batocera/gpu/gl4es/Config.in"
  endmenu

  menu "LED"
  source "$BR2_EXTERNAL_BATOCERA_PATH/package/batocera/leds/ayn-platform/Config.in"
  endmenu

  menu "Device trees"
  endmenu
endmenu

menu "Emulationstation"
  source "$BR2_EXTERNAL_BATOCERA_PATH/package/batocera/emulationstation/batocera-emulationstation/Config.in"
endmenu

menu "Libraries"
  source "$BR2_EXTERNAL_BATOCERA_PATH/package/batocera/libraries/libopenmpt/Config.in"
  source "$BR2_EXTERNAL_BATOCERA_PATH/package/batocera/libraries/libcapsimage/Config.in"
  source "$BR2_EXTERNAL_BATOCERA_PATH/package/batocera/libraries/libenet/Config.in"
  source "$BR2_EXTERNAL_BATOCERA_PATH/package/batocera/libraries/python-autobreadcrumbs/Config.in"
  source "$BR2_EXTERNAL_BATOCERA_PATH/package/batocera/libraries/wxwidgets/Config.in"
  source "$BR2_EXTERNAL_BATOCERA_PATH/package/batocera/libraries/ecm/Config.in"
  source "$BR2_EXTERNAL_BATOCERA_PATH/package/batocera/libraries/iir/Config.in"
  source "$BR2_EXTERNAL_BATOCERA_PATH/package/batocera/libraries/libxmp/Config.in"
  source "$BR2_EXTERNAL_BATOCERA_PATH/package/batocera/libraries/projectm/Config.in"
  source "$BR2_EXTERNAL_BATOCERA_PATH/package/batocera/libraries/wildmidi/Config.in"
  source "$BR2_EXTERNAL_BATOCERA_PATH/package/batocera/libraries/appstream-glib/Config.in"
  source "$BR2_EXTERNAL_BATOCERA_PATH/package/batocera/libraries/python3-pyparsing/Config.in"
  source "$BR2_EXTERNAL_BATOCERA_PATH/package/batocera/libraries/python-adafruit-blinka/Config.in"
  source "$BR2_EXTERNAL_BATOCERA_PATH/package/batocera/libraries/python-adafruit-circuitpython-busdevice/Config.in"
  source "$BR2_EXTERNAL_BATOCERA_PATH/package/batocera/libraries/python-adafruit-circuitpython-typing/Config.in"
  source "$BR2_EXTERNAL_BATOCERA_PATH/package/batocera/libraries/python-adafruit-circuitpython-ws2801/Config.in"
  source "$BR2_EXTERNAL_BATOCERA_PATH/package/batocera/libraries/python-adafruit-platformdetect/Config.in"
  source "$BR2_EXTERNAL_BATOCERA_PATH/package/batocera/libraries/python-adafruit-pureio/Config.in"
  source "$BR2_EXTERNAL_BATOCERA_PATH/package/batocera/libraries/python-pyftdi/Config.in"
  source "$BR2_EXTERNAL_BATOCERA_PATH/package/batocera/libraries/python-sysv-ipc/Config.in"
  source "$BR2_EXTERNAL_BATOCERA_PATH/package/batocera/libraries/python-pyqt5-sip/Config.in"
  source "$BR2_EXTERNAL_BATOCERA_PATH/package/batocera/libraries/python-hidapi/Config.in"
  source "$BR2_EXTERNAL_BATOCERA_PATH/package/batocera/libraries/libliftoff/Config.in"
  source "$BR2_EXTERNAL_BATOCERA_PATH/package/batocera/libraries/python3-configobj/Config.in"
  source "$BR2_EXTERNAL_BATOCERA_PATH/package/batocera/libraries/libjpeg-bato/Config.in"
  source "$BR2_EXTERNAL_BATOCERA_PATH/package/batocera/libraries/faudio/Config.in"
  source "$BR2_EXTERNAL_BATOCERA_PATH/package/batocera/libraries/sdl12-compat/Config.in"
  source "$BR2_EXTERNAL_BATOCERA_PATH/package/batocera/libraries/sockpp/Config.in"
  source "$BR2_EXTERNAL_BATOCERA_PATH/package/batocera/libraries/cargs/Config.in"
  source "$BR2_EXTERNAL_BATOCERA_PATH/package/batocera/libraries/libzedmd/Config.in"
  source "$BR2_EXTERNAL_BATOCERA_PATH/package/batocera/libraries/libserum/Config.in"
  source "$BR2_EXTERNAL_BATOCERA_PATH/package/batocera/libraries/libpupdmd/Config.in"
  source "$BR2_EXTERNAL_BATOCERA_PATH/package/batocera/libraries/libdmdutil/Config.in"
  source "$BR2_EXTERNAL_BATOCERA_PATH/package/batocera/libraries/libdof/Config.in"
  source "$BR2_EXTERNAL_BATOCERA_PATH/package/batocera/libraries/libpinmame/Config.in"
  source "$BR2_EXTERNAL_BATOCERA_PATH/package/batocera/libraries/libaltsound/Config.in"
  source "$BR2_EXTERNAL_BATOCERA_PATH/package/batocera/libraries/batocera-luajit/Config.in"
  source "$BR2_EXTERNAL_BATOCERA_PATH/package/batocera/libraries/python3-gpiod/Config.in"
  source "$BR2_EXTERNAL_BATOCERA_PATH/package/batocera/libraries/libgraphene/Config.in"
  source "$BR2_EXTERNAL_BATOCERA_PATH/package/batocera/libraries/libportmidi/Config.in"
endmenu

menu "Audio"
  source "$BR2_EXTERNAL_BATOCERA_PATH/package/batocera/audio/rtmidi/Config.in"
  source "$BR2_EXTERNAL_BATOCERA_PATH/package/batocera/audio/chromebook-ucm-conf/Config.in"
  source "$BR2_EXTERNAL_BATOCERA_PATH/package/batocera/audio/chromebook-linux-audio/Config.in"
  source "$BR2_EXTERNAL_BATOCERA_PATH/package/batocera/audio/alsa-topology-conf/Config.in"
  source "$BR2_EXTERNAL_BATOCERA_PATH/package/batocera/audio/alsa-ucm-conf/Config.in"
  source "$BR2_EXTERNAL_BATOCERA_PATH/package/batocera/audio/zmusic/Config.in"
endmenu

endmenu

menu "REG.linux"

endmenu
```
